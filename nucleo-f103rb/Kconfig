## nucleo-f103rb/Kconfig
```kconfig
#
# For a description of the syntax of this configuration file,
# see the file kconfig-language.txt in the NuttX tools repository.
#

if ARCH_BOARD_NUCLEO_F103RB

config NUCLEO_F103RB_LCD
	bool "LCD 1602"
	depends on LCD
	select LCD_LCD1602
	---help---
		Enable the 2x16 Alphanumeric display
endif
```
